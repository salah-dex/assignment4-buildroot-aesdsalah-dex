## base_external/package/aesdchar/Config.in
```kconfig
config BR2_PACKAGE_AESDCHAR
    bool "AESD Char driver"
    help 
      Add support for aesd char driver kernel module
```

## base_external/package/ldd/Config.in
```kconfig
config BR2_PACKAGE_LDD
    bool "ldd kernel modules"
    help
      Build and install the ldd3 kernel modules (scull and misc-modules).
```
